## project/firmware/components/board/Kconfig
```kconfig
menu "Recorder disposable-card testing"

config RECORDER_TEST_FORMAT_SD_ON_MOUNT_FAILURE
    bool "Allow formatting the owner-approved disposable SD card on mount failure"
    default n
    depends on RECORDER_SPI_LCD_CONFIRMED
    help
        Destructive test-only option. Enable only after the owner explicitly
        approves loss of all data on the connected SD card. Normal firmware
        must leave this disabled. After the test, rebuild and flash with this
        option disabled before using any other card. This never formats ESP
        flash partitions and does not enable credential storage or write eFuses.

endmenu
```

## project/firmware/main/Kconfig.projbuild
```kconfig
menu "Recorder"
config RECORDER_SPI_LCD_CONFIRMED
    bool "Physical SPI LCD jumper configuration has been verified"
    default n
    help
        Verify P5: IO_SEL to LCD_DC, IIC_INT isolated from SPI_MISO,
        no RGB touch controller or 1WIRE device driving GPIO40.
        Without this selection GPIO40 stays high impedance; serial status works.
config RECORDER_DEVELOPMENT_CREDENTIAL_RISK
    bool "Explicitly accept development-board physical credential extraction risk"
    depends on !NVS_ENCRYPTION
    default n
    help
        Allows credential persistence in ordinary NVS. This is NOT encrypted or
        secure against physical access. Never enable without the owner's approval.
config RECORDER_NVS_HMAC_EXISTING
    bool "Encrypted NVS using an already-provisioned protected HMAC key"
    depends on SOC_HMAC_SUPPORTED && NVS_ENCRYPTION && NVS_SEC_KEY_PROTECT_NONE
    depends on !SECURE_FLASH_ENC_ENABLED && !SECURE_BOOT
    default n
    help
        Requires an existing HMAC_UP eFuse key with read, write, and purpose
        write protection. This profile never generates keys or programs eFuses.
        Select NVS Encryption and key protection scheme None first; firmware
        installs a read-only HMAC provider instead of the SDK auto-generation path.
config RECORDER_NVS_HMAC_KEY_ID
    int "Already-provisioned HMAC key ID (KEY0 through KEY5)"
    depends on RECORDER_NVS_HMAC_EXISTING
    range 0 5
    default 0
config RECORDER_CLIENT_ID
    string "Microsoft public application A client ID"
    default "bdbb7442-7892-471e-9ee4-95d4e9c02a37"
config RECORDER_PROXY_SCOPE
    string "API B delegated scope"
    default "api://30f56876-0c90-48b8-aff0-654b5000fd43/access_as_user"
config RECORDER_PROXY_URL
    string "Authenticated WSS proxy URL"
    default ""
endmenu
```

## project/firmware/sdkconfig.defaults
```kconfig
CONFIG_IDF_TARGET="esp32s3"
CONFIG_ESPTOOLPY_FLASHSIZE_16MB=y
CONFIG_PARTITION_TABLE_CUSTOM=y
CONFIG_PARTITION_TABLE_CUSTOM_FILENAME="partitions.csv"
CONFIG_SPIRAM=y
CONFIG_SPIRAM_MODE_OCT=y
CONFIG_SPIRAM_SPEED_80M=y
CONFIG_SPIRAM_USE_MALLOC=y
CONFIG_SPIRAM_MALLOC_RESERVE_INTERNAL=65536
CONFIG_FATFS_LFN_HEAP=y
CONFIG_FATFS_MAX_LFN=128
CONFIG_FATFS_FS_LOCK=6
CONFIG_FATFS_VFS_FSTAT_BLKSIZE=4096
CONFIG_MBEDTLS_CERTIFICATE_BUNDLE=y
CONFIG_ESP_HTTP_CLIENT_STRICT_HEADER_BUFFER=y
CONFIG_WS_BUFFER_SIZE=10240
CONFIG_WS_DYNAMIC_BUFFER=y
CONFIG_ESP_MAIN_TASK_STACK_SIZE=8192
CONFIG_BT_ENABLED=y
CONFIG_BT_NIMBLE_ENABLED=y
CONFIG_BT_NIMBLE_MAX_CONNECTIONS=1
CONFIG_ESP_PROTOCOMM_SUPPORT_SECURITY_VERSION_2=y
CONFIG_ESP_PROTOCOMM_SUPPORT_SECURITY_VERSION_0=n
CONFIG_ESP_PROTOCOMM_SUPPORT_SECURITY_VERSION_1=n
```
